## conf/machine/stm32mp1-som.conf
```bitbake
#@TYPE: Machine
#@NAME: stm32mp1-som
#@DESCRIPTION: Emcraft STM32MP1 SOM
#@NEEDED_BSPLAYERS: layers/meta-openembedded/meta-oe layers/meta-openembedded/meta-python

include conf/machine/stm32mp1-disco.conf
BOOTDEVICE_LABELS += "emmc"

UBOOT_CONFIG[trusted] = "stm32mp1_som_defconfig,,u-boot.stm32"
#UBOOT_CONFIG[optee] = "stm32mp1_som_defconfig,,u-boot.stm32"
UBOOT_CONFIG[basic] = "stm32mp1_som_defconfig,,u-boot.stm32"
STM32MP_DT_FILES_EV = "stm32mp1-som"
```

## conf/machine/stm32mp15-som.conf
```bitbake
#@TYPE: Machine
#@NAME: stm32mp1-som
#@DESCRIPTION: Emcraft STM32MP1 SOM
#@NEEDED_BSPLAYERS: layers/meta-openembedded/meta-oe layers/meta-openembedded/meta-python

include conf/machine/stm32mp15-eval.conf

BOOTDEVICE_LABELS = "emmc sdcard"

STM32MP_DT_FILES_SDCARD := "stm32mp157-somic"
STM32MP_DT_FILES_EMMC := "stm32mp157-somic"

KERNEL_DEVICETREE := "stm32mp157-somic.dtb"

UBOOT_CONFIG[stm32mp157-somic] = "stm32mp157_somic_defconfig"

UBOOT_EXTLINUX_TARGETS_EXTRA_CONFIG:target-emmc = "stm32mp157-somic"
UBOOT_EXTLINUX_TARGETS_EXTRA_CONFIG:target-sdcard = "stm32mp157-somic"
UBOOT_EXTLINUX_TARGETS_EXTRA_CONFIG[stm32mp157-somic] = "stm32mp157-somic"

UBOOT_EXTLINUX_DEFAULT_LABEL:stm32mp157-somic = "stm32mp157-somic"
UBOOT_EXTLINUX_TIMEOUT = "1"

UBOOT_EXTLINUX_FDT:stm32mp157-somic = "stm32mp157-somic.dtb"

LINUX_A7_EXAMPLES_DT := ""
CUBE_M4_EXAMPLES_DT := ""
```

## conf/machine/stm32mp157d-som.conf
```bitbake
#@TYPE: Machine
#@NAME: stm32mp157d-som
#@DESCRIPTION: Emcraft STM32MP1 SOM 800MHz
#@NEEDED_BSPLAYERS: layers/meta-openembedded/meta-oe layers/meta-openembedded/meta-python

include conf/machine/stm32mp15-eval.conf

BOOTDEVICE_LABELS = "emmc sdcard"

UBOOT_CONFIG[trusted] = "stm32mp157d_som_defconfig,,u-boot.stm32"
UBOOT_CONFIG[optee] = "stm32mp157d_som_defconfig,,u-boot.stm32"
UBOOT_CONFIG[basic] = "stm32mp157d_som_defconfig,,u-boot.stm32"
#STM32MP_DT_FILES_EV = "stm32mp1-som"
STM32MP_DT_FILES_SDCARD = "stm32mp157d-som"
STM32MP_DT_FILES_EMMC = "stm32mp157d-som"
#STM32MP_DT_FILES_EMMC = "stm32mp157f-dk2"
```
